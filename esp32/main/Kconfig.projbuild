## esp32/main/Kconfig.projbuild
```kconfig
menu "Flip clock"

    config FLIPCLOCK_STEPS_PER_CYCLE
        int "Motor steps per cycle"
        range 1 65535
        default 1280
        help
            Stepper steps for one full turn of the flip mechanism.
            Copal 227: 1280. GE 7-4305: 2048.

    config FLIPCLOCK_MINUTES_PER_CYCLE
        int "Minutes per cycle"
        range 1 1440
        default 9
        help
            Minutes the display advances in one full turn of the flip mechanism.
            Copal 227: 9. GE 7-4305: 15.

    config FLIPCLOCK_MAX_PAUSE_MINUTES
        int "Longest pause when the display is ahead, in minutes"
        range 0 720
        default 120
        help
            A flip clock cannot go backwards. When the display is ahead of local time by
            up to this many minutes, as after a DST fall-back, the clock waits for time to
            catch up. When it is further ahead, the clock winds forward the long way round,
            which takes up to a day of flips.

    menu "Stepper wiring"

        config FLIPCLOCK_IN1_GPIO
            int "GPIO wired to the driver board's IN1"
            range 0 48
            default 18
            help
                The defaults for IN1 to IN4 (GPIO 18 to 21) avoid the ESP32-C6's strapping,
                USB, UART0 and SPI flash pins. Check that your board brings them out.

        config FLIPCLOCK_IN2_GPIO
            int "GPIO wired to the driver board's IN2"
            range 0 48
            default 19

        config FLIPCLOCK_IN3_GPIO
            int "GPIO wired to the driver board's IN3"
            range 0 48
            default 20

        config FLIPCLOCK_IN4_GPIO
            int "GPIO wired to the driver board's IN4"
            range 0 48
            default 21

        config FLIPCLOCK_REVERSE
            bool "Reverse the motor"
            default n
            help
                Turn the motor the other way. Set this when the flaps do not fall
                because the motor turns backwards.

        config FLIPCLOCK_STEP_PERIOD_US
            int "Time between steps, in microseconds"
            range 1000 20000
            default 3000
            help
                3000 matches the Arduino version. A longer time gives the motor more
                torque per step, which can cure stalls at the cost of a slower flip.

    endmenu

endmenu
```
